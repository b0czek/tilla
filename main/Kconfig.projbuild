## main/Kconfig.projbuild
```kconfig
menu "REST Server Configuration"

    config MDNS_HOST_NAME
        string "mDNS Host Name"
        default "tilla-node"
        help
            Specify the domain name used in the mDNS service.
            Note that webpage also take it as a part of URL where it will send GET/POST requests to.
    config WEB_MOUNT_POINT
        string "Website mount point in VFS"
        default "/www"
        help
            Specify the mount point in VFS.

endmenu
```

## main/display/Kconfig.projbuild
```kconfig
menu "Display config"
    config USE_DISPLAY
        bool "use display"
        default n
    if USE_DISPLAY    
        config LV_HOR_RES_MAX
            int "Maximal horizontal resolution to support by the library."
            default 240

        config LV_VER_RES_MAX
            int "Maximal vertical resolution to support by the library."
            default 320 

        config ENCODER_ENABLE 
            bool "Use encoder"
            default y

        if ENCODER_ENABLE
            config ENCODER_GPIO_A
                int "Rotary Encoder A output GPIO number"
                range 0 39
                default 39
            
            config ENCODER_GPIO_B
                int "Rotary Encoder B output GPIO number"
                range 0 39
                default 36
        endif

        config ALARM_ENABLE
            bool "Enable alarm"
            default n
        if ALARM_ENABLE
            config ALARM_OUTPUT_GPIO
                int "Alarm output GPIO number"
                range 0 39
            config ALARM_TRIGGERED_STATE
                int "State of a GPIO when alarm is triggered"
                range 0 1
                default 1
                
        endif

    endif

endmenu
```

## main/drivers/Kconfig.projbuild
```kconfig
menu "Sensor drivers configuration"
    menu "DS18B20"
        config DS18B20_ENABLED
            bool "Use DS18B20 sensors"
            default n
        if DS18B20_ENABLED
            config DS18B20_READING_INTERVAL
                int "DS18B20 reading interval"
                default 1000
            config DS18B20_GPIO
                int "DS18B20 GPIO number"
                range 0 34
                default 4
            config DS18B20_RESOLUTION
                int "DS18B20 resolution"
                range 9 12
                default 12
        endif
    endmenu
    
    menu "BME280"
        config BME280_ENABLED
            bool "Use BME280 sensors"
            default n
        if BME280_ENABLED
            config BME280_READING_INTERVAL
                int "BME280 reading interval"
                default 1000

            config USE_I2C_BUS_0
                bool "Use I2C bus 0"
                default y
            if USE_I2C_BUS_0
                config I2C_BUS_0_SDA
                    int "I2C bus 0 SDA gpio number"
                    default 16
                config I2C_BUS_0_SCL
                    int "I2C bus 0 SCL gpio number"
                    default 4
                config I2C_BUS_0_PULLUP_SDA
                    bool "I2C bus 0 SDA gpio pullup enable"
                    default y
                config I2C_BUS_0_PULLUP_SCL
                    bool "I2C bus 0 SDA gpio pullup enable"
                    default y
            endif

            config USE_I2C_BUS_1
                bool "Use I2C bus 1"
                default n
            if USE_I2C_BUS_1
                config I2C_BUS_1_SDA
                    int "I2C bus 1 SDA gpio number"
                    default 16
                config I2C_BUS_1_SCL
                    int "I2C bus 1 SCL gpio number"
                    default 4
                config I2C_BUS_1_PULLUP_SDA
                    bool "I2C bus 1 SDA gpio pullup enable"
                    default y
                config I2C_BUS_1_PULLUP_SCL
                    bool "I2C bus 1 SCL gpio pullup enable"
                    default y
            endif


            config BME280_SENSOR_CONFIGS
                string "BME280 sensor configs"
                default "0x76@0"
                help 
                    configuration of sensors, in format hex_address_of_sensor@i2c_bus, separated by commas
        endif

    endmenu


endmenu
```

## main/network/Kconfig.projbuild
```kconfig
menu "Connection Configuration"
    menu "WiFI Interface"
        config CONNECT_WIFI
            bool "connect using WiFi interface"
            default y
            help
                Boards can use Wi-Fi and/or Ethernet to connect to the network.
                Choose this option to connect with WiFi

        if CONNECT_WIFI
            config WIFI_SSID
                string "WiFi SSID"
                default "myssid"
                help
                    SSID (network name) for the board to connect to.

            config WIFI_PASSWORD
                string "WiFi Password"
                default "mypassword"
                help
                    WiFi password (WPA or WPA2) for the board to use.
                    Can be left blank if the network has no security set.
            config WIFI_HOSTNAME
                string "Interface's hostname"
                default "tilla-node-1-wifi"
                help
                    Hostname that the interface will use while communicating in the network.
            config WIFI_USE_STATIC_IP
                bool "connect WiFi using statically set IP address"
                default n
                help
                    Manually assign IP addresses for the board
            if WIFI_USE_STATIC_IP
                    config WIFI_STATIC_IP_ADDRESS
                        string "IP Address"
                        default "192.168.1.50"
                        help
                            IP address of the board
                    config WIFI_STATIC_NETMASK
                        string "Subnet mask"
                        default "255.255.255.0"
                        help
                            Subnet mask that the board will use 
                    config WIFI_STATIC_GATEWAY_ADDRESS
                        string "Gateway Address"
                        default "192.168.1.1"
                        help
                            IP address of a gateway
            endif
        endif
    endmenu
    menu "Ethernet Interface"
        config CONNECT_ETHERNET
            bool "connect using Ethernet interface"
            default n
            help
                Boards can use Wi-Fi and/or Ethernet to connect to the network.
                Choose this option to connect with Ethernet

        if CONNECT_ETHERNET
            config ETHERNET_HOSTNAME
            string "Interface's hostname"
            default "tilla-node-1-eth"
            help
                Hostname that the interface will use while communicating in the network.
            config ETHERNET_USE_STATIC_IP
                bool "connect ethernet using statically set IP address"
                default n
                help
                    Manually assign IP addresses for the ethernet NIC
                    
            if ETHERNET_USE_STATIC_IP
                    config ETHERNET_STATIC_IP_ADDRESS
                        string "IP Address"
                        default "192.168.1.60"
                        help
                            IP address of the ethernet NIC
                    config ETHERNET_STATIC_NETMASK
                        string "Subnet mask"
                        default "255.255.255.0"
                        help
                            Subnet mask that the ethernet NIC will use 
                    config ETHERNET_STATIC_GATEWAY_ADDRESS
                        string "Gateway Address"
                        default "192.168.1.1"
                        help
                            IP address of a gateway
                        
            endif
            choice USE_ETHERNET
                prompt "Ethernet Type"
                default USE_INTERNAL_ETHERNET if IDF_TARGET_ESP32
                default USE_DM9051 if !IDF_TARGET_ESP32
                help
                    Select which kind of Ethernet will be used in the build.

                config USE_INTERNAL_ETHERNET
                    depends on IDF_TARGET_ESP32
                    select ETH_USE_ESP32_EMAC
                    bool "Internal EMAC"
                    help
                        Select internal Ethernet MAC controller.

                config USE_DM9051
                    bool "DM9051 Module"
                    select ETH_USE_SPI_ETHERNET
                    select ETH_SPI_ETHERNET_DM9051
                    help
                        Select external SPI-Ethernet module.

                config USE_OPENETH
                    bool "OpenCores Ethernet MAC (EXPERIMENTAL)"
                    select ETH_USE_OPENETH
                    help
                        When this option is enabled, the program is built with support for
                        OpenCores Ethernet MAC, which allows testing the program in QEMU.
                        Note that this option is used for internal testing purposes, and
                        not officially supported. Programs built with this option enabled
                        will not run on a real ESP32 chip.

            endchoice

            if USE_INTERNAL_ETHERNET
                choice ETH_PHY_MODEL
                    prompt "Ethernet PHY Device"
                    default ETH_PHY_IP101
                    help
                        Select the Ethernet PHY device to use in the program.

                    config ETH_PHY_IP101
                        bool "IP101"
                        help
                            IP101 is a single port 10/100 MII/RMII/TP/Fiber Fast Ethernet Transceiver.
                            Goto http://www.icplus.com.tw/pp-IP101G.html for more information about it.

                    config ETH_PHY_RTL8201
                        bool "RTL8201/SR8201"
                        help
                            RTL8201F/SR8201F is a single port 10/100Mb Ethernet Transceiver with auto MDIX.
                            Goto http://www.corechip-sz.com/productsview.asp?id=22 for more information about it.

                    config ETH_PHY_LAN8720
                        bool "LAN8720"
                        help
                            LAN8720A is a small footprint RMII 10/100 Ethernet Transceiver with HP Auto-MDIX Support.
                            Goto https://www.microchip.com/LAN8720A for more information about it.

                    config ETH_PHY_DP83848
                        bool "DP83848"
                        help
                            DP83848 is a single port 10/100Mb/s Ethernet Physical Layer Transceiver.
                            Goto http://www.ti.com/product/DP83848J for more information about it.
                endchoice

                config ETH_MDC_GPIO
                    int "SMI MDC GPIO number"
                    default 23
                    help
                        Set the GPIO number used by SMI MDC.

                config ETH_MDIO_GPIO
                    int "SMI MDIO GPIO number"
                    default 18
                    help
                        Set the GPIO number used by SMI MDIO.
            endif

            if USE_DM9051
                config DM9051_SPI_HOST
                    int "SPI Host Number"
                    range 0 2
                    default 1
                    help
                        Set the SPI host used to communicate with DM9051.

                config DM9051_SCLK_GPIO
                    int "SPI SCLK GPIO number"
                    range 0 33
                    default 19
                    help
                        Set the GPIO number used by SPI SCLK.

                config DM9051_MOSI_GPIO
                    int "SPI MOSI GPIO number"
                    range 0 33
                    default 23
                    help
                        Set the GPIO number used by SPI MOSI.

                config DM9051_MISO_GPIO
                    int "SPI MISO GPIO number"
                    range 0 33
                    default 25
                    help
                        Set the GPIO number used by SPI MISO.

                config DM9051_CS_GPIO
                    int "SPI CS GPIO number"
                    range 0 33
                    default 22
                    help
                        Set the GPIO number used by SPI CS.

                config DM9051_SPI_CLOCK_MHZ
                    int "SPI clock speed (MHz)"
                    range 20 80
                    default 20
                    help
                        Set the clock speed (MHz) of SPI interface.

                config DM9051_INT_GPIO
                    int "Interrupt GPIO number"
                    default 4
                    help
                        Set the GPIO number used by DM9051 interrupt.
            endif

            config ETH_PHY_RST_GPIO
                int "PHY Reset GPIO number"
                default 17
                help
                    Set the GPIO number used to reset PHY chip.
                    Set to -1 to disable PHY chip hardware reset.

            config ETH_PHY_ADDR
                int "PHY Address"
                range 0 31 if USE_INTERNAL_ETHERNET
                range 1 1 if !USE_INTERNAL_ETHERNET
                default 1
                help
                    Set PHY address according your board schematic.
        endif
    endmenu

    config USE_STATIC_DNS
        bool "set DNS addresses statically"
        default y if WIFI_USE_STATIC_IP || ETHERNET_USE_STATIC_IP
        default n if !WIFI_USE_STATIC_IP && !ETHERNET_USE_STATIC_IP
        help
            Manaully assign DNS addresses for the board's networking
    if USE_STATIC_DNS
            config STATIC_DNS_PRIMARY
                string "Primary DNS Address"
                default "192.168.1.1"
                help 
                    IP address of primary DNS server
            
            config STATIC_DNS_SECONDARY
                string "Secondary DNS Address"
                default "8.8.8.8"
                help 
                    IP address of secondary DNS server
            
    endif


    config CONNECT_IPV6
        bool "Obtain IPv6 address"
        default n
        help
            By default, program will wait until IPv4 and IPv6 local link addresses are obtained.
            Disable this option if the network does not support IPv6.
            Choose the preferred IPv6 address type if the connection code should wait until other than
            the local link address gets assigned.

    if CONNECT_IPV6
        choice CONNECT_PREFERRED_IPV6
            prompt "Preferred IPv6 Type"
            default CONNECT_IPV6_PREF_LOCAL_LINK
            help
                Select which kind of IPv6 address the connect logic waits for.

            config CONNECT_IPV6_PREF_LOCAL_LINK
                bool "Local Link Address"
                help
                    Blocks until Local link address assigned.

            config CONNECT_IPV6_PREF_GLOBAL
                bool "Global Address"
                help
                    Blocks until Global address assigned.

            config CONNECT_IPV6_PREF_SITE_LOCAL
                bool "Site Local Address"
                help
                    Blocks until Site link address assigned.

            config CONNECT_IPV6_PREF_UNIQUE_LOCAL
                bool "Unique Local Link Address"
                help
                    Blocks until Unique local address assigned.

        endchoice

    endif


endmenu
```
